//Developed by ChenTheDesignMaker(DesignMaker@youtube)

#include <SPI.h>
#include <Wire.h>
#include <Adafruit_GFX.h>
#include <Adafruit_SSD1306.h>
#include <Fonts/LazenbyComputer-LiquidNumOnly32pt.h> //custom font

//-----------------[Define all graphics]------------------------
// 'StopSign', 108x48px
const unsigned char StopSign [] PROGMEM = {
  0x00, 0x7f, 0xfc, 0x7f, 0xff, 0xff, 0xff, 0xff, 0xff, 0xff, 0xe3, 0xff, 0xe0, 0x00, 0x00, 0xc0,
  0x04, 0x00, 0x00, 0x00, 0x00, 0x00, 0x00, 0x00, 0x02, 0x00, 0x30, 0x00, 0x01, 0x80, 0x04, 0x00,
  0x00, 0x00, 0x00, 0x00, 0x00, 0x00, 0x02, 0x00, 0x18, 0x00, 0x01, 0x00, 0x04, 0x00, 0x00, 0x00,
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  0x30, 0x00, 0x00, 0x7f, 0xff, 0xfe, 0x00, 0x00, 0x00, 0x00, 0x00, 0x07, 0xff, 0xff, 0xe0, 0x00
};
// 'LeftTopPointer', 11x11px
const unsigned char LeftTop [] PROGMEM = {
  0x00, 0x00, 0x08, 0x00, 0x1c, 0x00, 0x36, 0x00, 0x6b, 0x00, 0x35, 0x80, 0x1a, 0xc0, 0x0d, 0x60,
  0x06, 0xa0, 0x03, 0x20, 0x01, 0xe0
};

const unsigned char LeftBot [] PROGMEM = {
  // 'BL', 11x11px
  0x01, 0xe0, 0x03, 0x20, 0x06, 0xa0, 0x0d, 0x60, 0x1a, 0xc0, 0x35, 0x80, 0x6b, 0x00, 0x36, 0x00,
  0x1c, 0x00, 0x08, 0x00, 0x00, 0x00,
};

const unsigned char RightTop [] PROGMEM = {
  // 'TR', 11x11px
  0x00, 0x00, 0x02, 0x00, 0x07, 0x00, 0x0d, 0x80, 0x1a, 0xc0, 0x35, 0x80, 0x6b, 0x00, 0xd6, 0x00,
  0xac, 0x00, 0x98, 0x00, 0xf0, 0x00
};

const unsigned char RightBot [] PROGMEM = {
  // 'BR', 11x11px
  0xf0, 0x00, 0x98, 0x00, 0xac, 0x00, 0xd6, 0x00, 0x6b, 0x00, 0x35, 0x80, 0x1a, 0xc0, 0x0d, 0x80,
  0x07, 0x00, 0x02, 0x00, 0x00, 0x00,
};
//[End of graphics]--------------------------------------------------

//Display Setup
#define SCREEN_WIDTH 128 // OLED display width, in pixels
#define SCREEN_HEIGHT 64 // OLED display height, in pixels

// Declaration for SSD1306 display connected using software SPI (default case):
#define OLED_MOSI   12
#define OLED_CLK   11
#define OLED_DC    10
#define OLED_CS    8
#define OLED_RESET 9
Adafruit_SSD1306 display(SCREEN_WIDTH, SCREEN_HEIGHT,
                         OLED_MOSI, OLED_CLK, OLED_DC, OLED_RESET, OLED_CS);


//pin set up, if wiring differently, make sure you update here
#define SENSOR_PIN1 3
#define SENSOR_PIN2 4
#define SENSOR_PIN3 5
#define SENSOR_PIN4 6
#define MOTOR_PIN 2


//setup variables
int sensorReading1;
int sensorReading2;
int sensorReading3;
int sensorReading4;
int timer;
const int timerLimit = 30;//this determines how long it delays to make a new count up
int counter;
bool sensorTriggered = false;
const int hittingTime = 250;
const int xlHittingTime = 1200;
const int jackpotHittingTime = 5000;




void setup() {
  // put your setup code here, to run once:

  display.setFont(&LazenbyComputer_LiquidNumOnly32pt7b);
  pinMode(SENSOR_PIN1, INPUT);
  pinMode(SENSOR_PIN2, INPUT);
  pinMode(SENSOR_PIN3, INPUT);
  pinMode(SENSOR_PIN4, INPUT);
  pinMode(MOTOR_PIN, OUTPUT);
  Serial.begin(9600);
  // SSD1306_SWITCHCAPVCC = generate display voltage from 3.3V internally
  if (!display.begin(SSD1306_SWITCHCAPVCC)) {
    Serial.println(F("SSD1306 allocation failed"));
    for (;;); // Don't proceed, loop forever


    display.display();
    delay(2000); // Pause for 2 seconds
    display.clearDisplay();

    // Draw a single pixel in white
    display.drawPixel(10, 10, SSD1306_WHITE);

    // Show the display buffer on the screen. You MUST call display() after
    // drawing commands to make them visible on screen!
    display.display();
    delay(2000);
  }
}





void loop() {
  //read all sensors at each loop
  sensorReading1 = digitalRead(SENSOR_PIN1);
  sensorReading2 = digitalRead(SENSOR_PIN2);
  sensorReading3 = digitalRead(SENSOR_PIN3);
  sensorReading4 = digitalRead(SENSOR_PIN4);

  //if any of sensor detect objects, which will send LOW through the signal line
  if (sensorReading1 == LOW || sensorReading2 == LOW || sensorReading3 == LOW || sensorReading4 == LOW) { //sensor triggered

    if (sensorTriggered == false) {
      if (timer == 0) {
        counter++;
        Serial.println("reading is LOW");
        //to do make different time based on number of touches?

        
        drawStop();
        if (sensorReading1 == LOW) {
          Serial.println("Sensor1 is Triggered LOW" );
          drawCorners(RightBot, 128 - 11, 64 - 11);
        }
        if (sensorReading2 == LOW) {
          Serial.println("Sensor2 is Triggered LOW" );
          drawCorners(RightTop, 128 - 11, 0);
        }
        if (sensorReading3 == LOW) {
          Serial.println("Sensor3 is Triggered LOW" );
          drawCorners(LeftTop, 0, 0);
        }
        if (sensorReading4 == LOW) {
          Serial.println("Sensor4 is Triggered LOW" );
          drawCorners(LeftBot, 0, 53);
        }
        digitalWrite(MOTOR_PIN, 1);

        if(counter%10 == 0){
          if(counter%100 ==0){
            delay(jackpotHittingTime);
            }
          else delay(xlHittingTime);
          }

        else delay(hittingTime);
        
        
        displayCounter();
      }
      timer = timerLimit;
      sensorTriggered = true;//have this flag so it won't hit or have multiple counts, until when the timer reached to clear the flag

    }
  }
  else {//if all sensors are not triggered, clear the sensorTriggered flag and stop the motor
    sensorTriggered = false;
    digitalWrite(MOTOR_PIN, 0);
    if (timer > 0) {
      timer--;
      Serial.println(timer);
      delay(10);
    }
  }

}


void displayCounter(void) {
  display.clearDisplay();
  display.setTextSize(1);             // Normal 1:1 pixel scale
  display.setTextColor(SSD1306_WHITE);        // Draw white text
  display.setCursor(0, 60);            // Start at top-left corner

  //display "00" at single digit and "0" for double digits for cosmatics
  switch (counter) {
    case 0 ...9:
      display.println("00" + String(counter));
      break;
    case 10 ...99:
      display.println("0" + String(counter));
      break;
    default:
      display.println(counter);
      break;
  }

  display.display();      // Show initial text


}
void drawCorners( const uint8_t corner[], int x, int y) {

  display.drawBitmap(
    x, y, corner, 12, 12, 1);

  display.display();
  delay(500);
}

void drawStop(void) {
  display.clearDisplay();

  display.drawBitmap(
    10, 8, StopSign, 108, 48, 1);

  display.display();

}
